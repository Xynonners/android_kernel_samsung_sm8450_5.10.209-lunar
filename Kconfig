## Kconfig
```kconfig
# SPDX-License-Identifier: GPL-2.0
#
# For a description of the syntax of this configuration file,
# see Documentation/kbuild/kconfig-language.rst.
#
mainmenu "Linux/$(ARCH) $(KERNELVERSION) Kernel Configuration"

source "scripts/Kconfig.include"

source "init/Kconfig"

source "kernel/Kconfig.freezer"

source "fs/Kconfig.binfmt"

source "mm/Kconfig"

source "net/Kconfig"

source "drivers/Kconfig"

source "fs/Kconfig"

source "security/Kconfig"

source "crypto/Kconfig"

source "lib/Kconfig"

source "lib/Kconfig.debug"

source "Documentation/Kconfig"

config SCHED_WALT
	tristate
	depends on SMP
	default y
	help
	This feature will allow the scheduler to maintain a tunable window
	based set of metrics for tasks and runqueues. These metrics can be
	used to guide task placement as well as task frequency requirements
	for cpufreq governors.
```

## drivers/cpufreq/cpufreq_bouncing/Kconfig
```kconfig
config OPLUS_FEATURE_CPUFREQ_BOUNCING
	tristate "OPLUS CPUFreq Bouncing Driver"
	default n
	help
	  Dynamically adjust the maximum CPU frequency based on CPU utilization
	  and busy duration.
```

## drivers/cpufreq/cpufreq_effiency/Kconfig
```kconfig
config OPLUS_FEATURE_CPUFREQ_EFFIENCY
	tristate "OPLUS CPUFreq Effiency Driver"
	default n
	help
	  Enable dynamic CPU frequency selection based on power domain effiency.

	  This feature optimizes CPU frequency transitions by selecting
	  the most effient frequency point based on the current operating
	  frequency and the power domain characteristics.
```

## drivers/cpufreq/cpufreq_health/Kconfig
```kconfig
config OPLUS_FEATURE_CPUFREQ_HEALTH
	tristate "OPLUS CPUFreq Health Driver"
	depends on SMP
	default n
	help
	  Enable the OPLUS CPUFreq Health Driver which collects and reports
	  statistics related to CPU frequency scaling and voltage regulation.
```

## kernel/sched/eas_opt/Kconfig
```kconfig
menu "Oplus EAS Optimizations"

config OPLUS_FEATURE_EAS_OPT
    bool "Enable Oplus Energy Aware Scheduling (EAS) Optimization"
    default n
    help
      Enable this option to include Oplus-specific EAS optimizations
      that improve CPU scheduling for better power efficiency.

config OPLUS_EAS_FAKE_CAP
    bool "Enable Fake CPU Capacity Adjustment"
    default n
    depends on OPLUS_FEATURE_EAS_OPT
    help
      This enables a fake CPU capacity mechanism, allowing dynamic
      adjustment of CPU capacities for better load balancing.

config OPLUS_EAS_CPUFREQ_IOWAIT_PROTECT
    bool "Enable CPUFreq IO Wait Protection"
    default n
    depends on OPLUS_FEATURE_EAS_OPT
    help
      Enables IO wait-based CPU frequency protection, improving
      responsiveness under high IO wait conditions.

endmenu
```

## kernel/sched/frame_boost/Kconfig
```kconfig
menu "Oplus Frame Boost Features"

config OPLUS_FEATURE_FRAME_BOOST
    bool "Enable Oplus Frame Boost"
    default n
    help
      This option enables Oplus Frame Boost, a CPU scheduling optimization
      that improves UI rendering and gaming performance by dynamically
      adjusting CPU frequencies and task placements.

config OPLUS_FRAME_MULTI_FBG
    bool "Enable Multi Frame Boost Group (Multi-FBG)"
    depends on OPLUS_FEATURE_FRAME_BOOST
    default n
    help
      Multi-FBG (Multi Frame Boost Group) is an improved version of Oplus
      Frame Boost that provides more efficient CPU scheduling by managing
      multiple frame-rendering threads in groups. This improves UI smoothness
      and gaming performance while reducing power consumption.

config OPLUS_FRAME_VT_CAP
	bool
	default n
	depends on OPLUS_FEATURE_FRAME_BOOST && OPLUS_FRAME_MULTI_FBG

config OPLUS_FEATURE_SLIDE_BOOST
	bool
	default n
	depends on OPLUS_FEATURE_FRAME_BOOST && OPLUS_FRAME_MULTI_FBG

config OPLUS_SCHED_ADD_CORE_CTRL_MASK
	bool "Add core_ctrl mask cpu"
	default n
	depends on OPLUS_FEATURE_FRAME_BOOST

endmenu
```

## kernel/sched/uag/Kconfig
```kconfig
config OPLUS_CPU_FREQ_GOV_UAG
	tristate "'uag' cpufreq policy governor"
	depends on CPU_FREQ && SMP && SCHED_WALT && OPLUS_FEATURE_CPUFREQ_HEALTH
	select CPU_FREQ_GOV_ATTR_SET
	select IRQ_WORK
	help
	  This governor makes decisions based on the utilization.  It sets
	  the CPU frequency to be proportional to the utilization/capacity
	  ratio coming from the scheduler or frameboost.  If the utilization
	  is frequency-invariant, the new frequency is also proportional to
	  the maximum available frequency.  If that is not the case, it is
	  proportional to the current frequency of the CPU.

	  If in doubt, say N.

menu "'uag' cpufreq policy governor options"
	depends on OPLUS_CPU_FREQ_GOV_UAG

config OPLUS_UAG_NONLINEAR_FREQ_CTL
	bool "Non-linear frequency control"
	depends on OPLUS_CPU_FREQ_GOV_UAG
	default n
	help
	  Choose this option to enable non-linear frequency control.
	  This will change per-opp capacity from linear scaled by
	  frequency to evaluated by benchmark. This makes capacity
	  more accurate and will let scheduler/schedutil use more
	  suitable frequency.

config OPLUS_UAG_USE_TL
	bool "Use target loads in uag cpufreq policy governor"
	depends on OPLUS_CPU_FREQ_GOV_UAG
	default n
	help
	  Add target_loads sysfs attr in uag cpufreq policy governor.

config OPLUS_UAG_AMU_AWARE
	bool "Consider amu info for cpufreq decision"
	depends on OPLUS_CPU_FREQ_GOV_UAG
	default n
	help
	  Consider AMU info such as cycles/stall ... to adjust cpufreq.

config OPLUS_UAG_MULTI_LV_TL
	bool "Add multi-level target loads to scale cpu frequency"
	depends on OPLUS_CPU_FREQ_GOV_UAG
	default n
	help
	  Add multi-level target loads to scale cpu frequency.

config OPLUS_UAG_TOUCH_BOOST
	bool "Enable touch-based CPU frequency boost"
	depends on OPLUS_CPU_FREQ_GOV_UAG
	default n
    help
      Enables dynamic CPU frequency boosting in response to user touch input events.
      When a touch event is detected (e.g., on a touchscreen, touchpad, or keypad),
      this feature temporarily increases the CPU's minimum frequency to improve
      responsiveness. The frequency boost is automatically reverted after a short
      duration.

config OPLUS_UAG_SOFT_LIMIT
	bool "Soft frequency limit in uag cpufreq policy governor"
	depends on OPLUS_CPU_FREQ_GOV_UAG
	default n
	help
	  Add soft frequency limit in uag cpufreq policy governor.
	  Frequency can breakthrough this limit in UA scene.

config UA_KERNEL_CPU_IOCTL
	tristate "cpu ioctl interface"
	depends on OPLUS_CPU_FREQ_GOV_UAG && OPLUS_FEATURE_FRAME_BOOST
	default n
	help
	  Provide ioctl interface for cpu features.

endmenu
```
